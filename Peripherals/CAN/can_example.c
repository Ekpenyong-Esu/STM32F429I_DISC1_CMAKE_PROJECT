/**
 * @file can_example.c
 * @brief CAN peripheral driver examples and usage patterns
 * @author Generated by GitHub Copilot
 * @date 2025
 */

#include "can.h"
#include <stdio.h>
#include <string.h>

/* Example constants */
#define EXAMPLE_TIMEOUT_MS          100U
#define EXAMPLE_LONG_TIMEOUT_MS     5000U
#define EXAMPLE_TIME_SEG1           13U
#define EXAMPLE_STD_ID              0x123U
#define EXAMPLE_EXT_ID              0x12345678U
#define EXAMPLE_RTR_ID              0x200U
#define EXAMPLE_FILTER_ID           0x100U
#define EXAMPLE_FILTER_MASK         0x700U
#define EXAMPLE_LOOPBACK_ID         0x555U
#define EXAMPLE_LIST_ID1            0x300U
#define EXAMPLE_LIST_ID2            0x301U
#define EXAMPLE_MASK_ID             0x400U
#define EXAMPLE_MASK_FILTER         0x7F0U

/* Example data constants */
#define EXAMPLE_BYTE_1              0x11U
#define EXAMPLE_BYTE_2              0x22U
#define EXAMPLE_BYTE_3              0x33U
#define EXAMPLE_BYTE_4              0x44U
#define EXAMPLE_BYTE_5              0x55U
#define EXAMPLE_BYTE_6              0x66U
#define EXAMPLE_BYTE_7              0x77U
#define EXAMPLE_BYTE_8              0x88U

/* Example callback functions */
static void CAN_TxCallback(uint8_t mailbox);
static void CAN_RxCallback(const CAN_Frame *frame);
static void CAN_ErrorCallback(CAN_ErrorType error);

/* Example data */
static uint8_t example_data[] = {
    EXAMPLE_BYTE_1, EXAMPLE_BYTE_2, EXAMPLE_BYTE_3, EXAMPLE_BYTE_4,
    EXAMPLE_BYTE_5, EXAMPLE_BYTE_6, EXAMPLE_BYTE_7, EXAMPLE_BYTE_8
};
static CAN_Status can_status;

/**
 * @brief Example 1: Basic CAN initialization and configuration
 * @return HAL_StatusTypeDef HAL status
 */
HAL_StatusTypeDef CAN_Example_BasicInit(void)
{
    CAN_Config config = {
        .mode = CAN_OP_MODE_NORMAL,
        .baud_rate = CAN_BAUD_500KBPS,
        .auto_retransmission = true,
        .auto_bus_off_recovery = true,
        .time_triggered_comm = false,
        .prescaler = 9,              /* For 500kbps at 45MHz APB1 */
        .sync_jump_width = 1,
        .time_segment_1 = 13,
        .time_segment_2 = 2
    };

    printf("Initializing CAN with 500kbps baud rate...\n");

    /* Initialize CAN */
    HAL_StatusTypeDef status = CAN_Init(&config);
    if (status != HAL_OK) {
        printf("CAN initialization failed!\n");
        return status;
    }

    printf("CAN initialized successfully\n");
    return HAL_OK;
}

/**
 * @brief Example 2: Configure CAN filters for message reception
 * @return HAL_StatusTypeDef HAL status
 */
HAL_StatusTypeDef CAN_Example_FilterConfig(void)
{
    CAN_FilterConfig filter_config = {
        .filter_bank = 0,
        .mode = CAN_FILTER_MODE_ID_MASK,
        .scale = CAN_FILTER_SCALE_32BIT,
        .id = EXAMPLE_FILTER_ID,        /* Accept messages with ID 0x100 */
        .mask = EXAMPLE_FILTER_MASK,    /* Mask for first 3 bits */
        .enable = true
    };

    printf("Configuring CAN filter for ID 0x100...\n");

    HAL_StatusTypeDef status = CAN_ConfigFilter(&filter_config);
    if (status != HAL_OK) {
        printf("CAN filter configuration failed!\n");
        return status;
    }

    printf("CAN filter configured successfully\n");
    return HAL_OK;
}

/**
 * @brief Example 3: Transmit a standard CAN frame
 * @return HAL_StatusTypeDef HAL status
 */
HAL_StatusTypeDef CAN_Example_TransmitStandard(void)
{
    CAN_Frame tx_frame = {
        .id = EXAMPLE_STD_ID,
        .frame_type = CAN_FRAME_STANDARD,
        .data_length = 8,
        .remote_request = false,
        .timestamp = 0
    };

    /* Copy example data */
    memcpy(tx_frame.data, example_data, 8);

    printf("Transmitting standard CAN frame (ID: 0x%03X)...\n", tx_frame.id);

    HAL_StatusTypeDef status = CAN_Transmit(&tx_frame, EXAMPLE_TIMEOUT_MS);
    if (status != HAL_OK) {
        printf("CAN transmission failed!\n");
        return status;
    }

    printf("CAN frame transmitted successfully\n");
    return HAL_OK;
}

/**
 * @brief Example 4: Transmit an extended CAN frame
 * @return HAL_StatusTypeDef HAL status
 */
HAL_StatusTypeDef CAN_Example_TransmitExtended(void)
{
    CAN_Frame tx_frame = {
        .id = EXAMPLE_EXT_ID,
        .frame_type = CAN_FRAME_EXTENDED,
        .data_length = 6,
        .remote_request = false,
        .timestamp = 0
    };

    /* Copy partial example data */
    memcpy(tx_frame.data, example_data, 6);

    printf("Transmitting extended CAN frame (ID: 0x%08X)...\n", (unsigned int)tx_frame.id);

    HAL_StatusTypeDef status = CAN_Transmit(&tx_frame, 100);
    if (status != HAL_OK) {
        printf("CAN transmission failed!\n");
        return status;
    }

    printf("Extended CAN frame transmitted successfully\n");
    return HAL_OK;
}

/**
 * @brief Example 5: Transmit a remote frame
 * @return HAL_StatusTypeDef HAL status
 */
HAL_StatusTypeDef CAN_Example_TransmitRemote(void)
{
    CAN_Frame tx_frame = {
        .id = 0x200,
        .frame_type = CAN_FRAME_STANDARD,
        .data_length = 8,           /* DLC for remote frame */
        .remote_request = true,
        .timestamp = 0
    };

    printf("Transmitting remote CAN frame (ID: 0x%03X)...\n", tx_frame.id);

    HAL_StatusTypeDef status = CAN_Transmit(&tx_frame, 100);
    if (status != HAL_OK) {
        printf("CAN remote transmission failed!\n");
        return status;
    }

    printf("Remote CAN frame transmitted successfully\n");
    return HAL_OK;
}

/**
 * @brief Example 6: Receive CAN frames with polling
 * @return HAL_StatusTypeDef HAL status
 */
HAL_StatusTypeDef CAN_Example_ReceivePolling(void)
{
    CAN_Frame rx_frame;
    uint32_t timeout = 5000; /* 5 second timeout */

    printf("Waiting for CAN frame (polling mode)...\n");

    HAL_StatusTypeDef status = CAN_Receive(&rx_frame, timeout);
    if (status != HAL_OK) {
        if (status == HAL_TIMEOUT) {
            printf("CAN receive timeout - no frame received\n");
        } else {
            printf("CAN receive failed!\n");
        }
        return status;
    }

    /* Display received frame */
    printf("Received CAN frame:\n");
    printf("  ID: 0x%08X (%s)\n",
           (unsigned int)rx_frame.id,
           rx_frame.frame_type == CAN_FRAME_STANDARD ? "Standard" : "Extended");
    printf("  DLC: %d\n", rx_frame.data_length);
    printf("  RTR: %s\n", rx_frame.remote_request ? "Yes" : "No");
    printf("  Data: ");
    for (uint8_t i = 0; i < rx_frame.data_length; i++) {
        printf("%02X ", rx_frame.data[i]);
    }
    printf("\n");

    return HAL_OK;
}

/**
 * @brief Example 7: Setup interrupt-driven reception
 * @return HAL_StatusTypeDef HAL status
 */
HAL_StatusTypeDef CAN_Example_InterruptSetup(void)
{
    printf("Setting up CAN interrupt callbacks...\n");

    /* Register callbacks */
    CAN_RegisterTxCallback(CAN_TxCallback);
    CAN_RegisterRxCallback(CAN_RxCallback);
    CAN_RegisterErrorCallback(CAN_ErrorCallback);

    /* Enable interrupts */
    HAL_StatusTypeDef status = CAN_EnableInterrupts();
    if (status != HAL_OK) {
        printf("CAN interrupt setup failed!\n");
        return status;
    }

    printf("CAN interrupts enabled successfully\n");
    return HAL_OK;
}

/**
 * @brief Example 8: Get CAN status and statistics
 * @return HAL_StatusTypeDef HAL status
 */
HAL_StatusTypeDef CAN_Example_GetStatus(void)
{
    HAL_StatusTypeDef status = CAN_GetStatus(&can_status);
    if (status != HAL_OK) {
        printf("Failed to get CAN status!\n");
        return status;
    }

    printf("CAN Status:\n");
    printf("  Initialized: %s\n", can_status.initialized ? "Yes" : "No");
    printf("  TX Mailboxes Free: %d\n", can_status.tx_mailbox_free);
    printf("  RX Messages Pending: %d\n", can_status.rx_messages_pending);
    printf("  Last Error: %d\n", can_status.last_error);
    printf("  Error Count: %d\n", can_status.error_count);
    printf("  TX Count: %d\n", can_status.tx_count);
    printf("  RX Count: %d\n", can_status.rx_count);

    return HAL_OK;
}

/**
 * @brief Example 9: CAN loopback mode for testing
 * @return HAL_StatusTypeDef HAL status
 */
HAL_StatusTypeDef CAN_Example_LoopbackMode(void)
{
    CAN_Config config = {
        .mode = CAN_OP_MODE_LOOPBACK,
        .baud_rate = CAN_BAUD_500KBPS,
        .auto_retransmission = true,
        .auto_bus_off_recovery = true,
        .time_triggered_comm = false,
        .prescaler = 9,
        .sync_jump_width = 1,
        .time_segment_1 = 13,
        .time_segment_2 = 2
    };

    printf("Initializing CAN in loopback mode...\n");

    /* Initialize CAN in loopback mode */
    HAL_StatusTypeDef status = CAN_Init(&config);
    if (status != HAL_OK) {
        printf("CAN loopback initialization failed!\n");
        return status;
    }

    /* Transmit a test frame */
    CAN_Frame tx_frame = {
        .id = 0x555,
        .frame_type = CAN_FRAME_STANDARD,
        .data_length = 4,
        .remote_request = false,
        .timestamp = 0
    };
    memcpy(tx_frame.data, example_data, 4);

    printf("Transmitting test frame in loopback mode...\n");
    status = CAN_Transmit(&tx_frame, 100);
    if (status != HAL_OK) {
        printf("Loopback transmission failed!\n");
        return status;
    }

    /* Receive the frame */
    CAN_Frame rx_frame;
    status = CAN_Receive(&rx_frame, 100);
    if (status != HAL_OK) {
        printf("Loopback reception failed!\n");
        return status;
    }

    /* Verify received data */
    if (memcmp(tx_frame.data, rx_frame.data, tx_frame.data_length) == 0) {
        printf("Loopback test successful - data matches!\n");
    } else {
        printf("Loopback test failed - data mismatch!\n");
    }

    return HAL_OK;
}

/**
 * @brief Example 10: Error handling and recovery
 * @return HAL_StatusTypeDef HAL status
 */
HAL_StatusTypeDef CAN_Example_ErrorHandling(void)
{
    printf("Demonstrating CAN error handling...\n");

    /* Clear any existing errors */
    HAL_StatusTypeDef status = CAN_ClearErrors();
    if (status != HAL_OK) {
        printf("Error clearing failed!\n");
        return status;
    }

    /* Get current status */
    status = CAN_GetStatus(&can_status);
    if (status != HAL_OK) {
        printf("Status retrieval failed!\n");
        return status;
    }

    printf("Current error count: %d\n", can_status.error_count);
    printf("Last error type: %d\n", can_status.last_error);

    return HAL_OK;
}

/**
 * @brief Example 11: Multiple filter configuration
 * @return HAL_StatusTypeDef HAL status
 */
HAL_StatusTypeDef CAN_Example_MultipleFilters(void)
{
    CAN_FilterConfig filter1 = {
        .filter_bank = 1,
        .mode = CAN_FILTER_MODE_ID_LIST,
        .scale = CAN_FILTER_SCALE_16BIT,
        .id = 0x300,
        .mask = 0x301,              /* Second ID for list mode */
        .enable = true
    };

    CAN_FilterConfig filter2 = {
        .filter_bank = 2,
        .mode = CAN_FILTER_MODE_ID_MASK,
        .scale = CAN_FILTER_SCALE_16BIT,
        .id = 0x400,
        .mask = 0x7F0,              /* Accept IDs 0x400-0x4FF */
        .enable = true
    };

    printf("Configuring multiple CAN filters...\n");

    HAL_StatusTypeDef status = CAN_ConfigFilter(&filter1);
    if (status != HAL_OK) {
        printf("Filter 1 configuration failed!\n");
        return status;
    }

    status = CAN_ConfigFilter(&filter2);
    if (status != HAL_OK) {
        printf("Filter 2 configuration failed!\n");
        return status;
    }

    printf("Multiple filters configured successfully\n");
    return HAL_OK;
}

/**
 * @brief Example 12: CAN bus monitoring (silent mode)
 * @return HAL_StatusTypeDef HAL status
 */
HAL_StatusTypeDef CAN_Example_SilentMode(void)
{
    CAN_Config config = {
        .mode = CAN_OP_MODE_SILENT,
        .baud_rate = CAN_BAUD_500KBPS,
        .auto_retransmission = false, /* No transmission in silent mode */
        .auto_bus_off_recovery = true,
        .time_triggered_comm = false,
        .prescaler = 9,
        .sync_jump_width = 1,
        .time_segment_1 = 13,
        .time_segment_2 = 2
    };

    printf("Initializing CAN in silent mode for bus monitoring...\n");

    HAL_StatusTypeDef status = CAN_Init(&config);
    if (status != HAL_OK) {
        printf("CAN silent mode initialization failed!\n");
        return status;
    }

    printf("CAN in silent mode - monitoring bus traffic...\n");
    printf("Note: Transmission is disabled in silent mode\n");

    return HAL_OK;
}

/**
 * @brief Main CAN example runner
 * @return int Exit status
 */
int CAN_RunExamples(void)
{
    printf("=== CAN Driver Examples ===\n\n");

    /* Example 1: Basic initialization */
    if (CAN_Example_BasicInit() != HAL_OK) {
        return -1;
    }

    /* Example 2: Filter configuration */
    if (CAN_Example_FilterConfig() != HAL_OK) {
        return -1;
    }

    /* Example 3: Standard frame transmission */
    if (CAN_Example_TransmitStandard() != HAL_OK) {
        return -1;
    }

    /* Example 4: Extended frame transmission */
    if (CAN_Example_TransmitExtended() != HAL_OK) {
        return -1;
    }

    /* Example 5: Remote frame transmission */
    if (CAN_Example_TransmitRemote() != HAL_OK) {
        return -1;
    }

    /* Example 6: Polling reception */
    if (CAN_Example_ReceivePolling() != HAL_OK) {
        printf("Note: Receive example may timeout if no messages are sent\n");
    }

    /* Example 7: Interrupt setup */
    if (CAN_Example_InterruptSetup() != HAL_OK) {
        return -1;
    }

    /* Example 8: Status reporting */
    if (CAN_Example_GetStatus() != HAL_OK) {
        return -1;
    }

    /* Example 9: Loopback testing */
    if (CAN_Example_LoopbackMode() != HAL_OK) {
        return -1;
    }

    /* Example 10: Error handling */
    if (CAN_Example_ErrorHandling() != HAL_OK) {
        return -1;
    }

    /* Example 11: Multiple filters */
    if (CAN_Example_MultipleFilters() != HAL_OK) {
        return -1;
    }

    /* Example 12: Silent mode */
    if (CAN_Example_SilentMode() != HAL_OK) {
        return -1;
    }

    printf("\n=== All CAN Examples Completed ===\n");
    return 0;
}

/* Callback function implementations */

/**
 * @brief CAN transmission complete callback
 * @param mailbox Mailbox number that completed transmission
 */
static void CAN_TxCallback(uint8_t mailbox)
{
    printf("CAN TX Callback: Mailbox %d transmission complete\n", mailbox);
}

/**
 * @brief CAN reception callback
 * @param frame Pointer to received CAN frame
 */
static void CAN_RxCallback(const CAN_Frame *frame)
{
    printf("CAN RX Callback: Received frame ID 0x%08X\n", (unsigned int)frame->id);
}

/**
 * @brief CAN error callback
 * @param error Error type
 */
static void CAN_ErrorCallback(CAN_ErrorType error)
{
    printf("CAN Error Callback: Error type %d occurred\n", error);
}
