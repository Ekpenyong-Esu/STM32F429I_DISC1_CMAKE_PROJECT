/**
 * @file crc_example.c
 * @brief CRC peripheral driver examples and usage patterns
 * @author Generated by GitHub Copilot
 * @date 2025
 */

#include "crc.h"
#include <stdio.h>

/* Example data constants */
#define EXAMPLE_BYTE_1          0x11U
#define EXAMPLE_BYTE_2          0x22U
#define EXAMPLE_BYTE_3          0x33U
#define EXAMPLE_BYTE_4          0x44U
#define EXAMPLE_BYTE_5          0x55U
#define EXAMPLE_BYTE_6          0x66U
#define EXAMPLE_BYTE_7          0x77U
#define EXAMPLE_BYTE_8          0x88U
#define EXAMPLE_WORD_1          0x11223344U
#define EXAMPLE_WORD_2          0x55667788U
#define EXAMPLE_WORD_3          0x99AABBCCU
#define CRC16_INIT_VALUE        0xFFFFU
#define CRC16_MASK              0xFFFFU

/* Example callback functions */
static void CRC_CompleteCallback(uint32_t crc_value);
static void CRC_ErrorCallback(CRC_ErrorType error);

/* Example data */
static uint8_t example_data[] = {
    EXAMPLE_BYTE_1, EXAMPLE_BYTE_2, EXAMPLE_BYTE_3, EXAMPLE_BYTE_4,
    EXAMPLE_BYTE_5, EXAMPLE_BYTE_6, EXAMPLE_BYTE_7, EXAMPLE_BYTE_8
};
static uint32_t example_data32[] = {EXAMPLE_WORD_1, EXAMPLE_WORD_2, EXAMPLE_WORD_3};
static CRC_Status crc_status;

/**
 * @brief Example 1: Basic CRC initialization and configuration
 * @return HAL_StatusTypeDef HAL status
 */
HAL_StatusTypeDef CRC_Example_BasicInit(void)
{
    CRC_Config config;

    printf("Initializing CRC with default configuration...\n");

    /* Get default configuration */
    CRC_GetDefaultConfig(&config);

    /* Initialize CRC */
    HAL_StatusTypeDef status = CRC_Init(&config);
    if (status != HAL_OK) {
        printf("CRC initialization failed!\n");
        return status;
    }

    printf("CRC initialized successfully\n");
    return HAL_OK;
}

/**
 * @brief Example 2: CRC calculation with byte data
 * @return HAL_StatusTypeDef HAL status
 */
HAL_StatusTypeDef CRC_Example_CalculateBytes(void)
{
    uint32_t crc_value = 0;

    printf("Calculating CRC for byte data...\n");
    printf("Data: ");
    for (size_t i = 0; i < sizeof(example_data); i++) {
        printf("%02X ", example_data[i]);
    }
    printf("\n");

    /* Calculate CRC */
    HAL_StatusTypeDef status = CRC_Calculate(example_data, sizeof(example_data), &crc_value);
    if (status != HAL_OK) {
        printf("CRC calculation failed!\n");
        return status;
    }

    printf("Calculated CRC: 0x%08X\n", crc_value);
    return HAL_OK;
}

/**
 * @brief Example 3: CRC calculation with 32-bit word data
 * @return HAL_StatusTypeDef HAL status
 */
HAL_StatusTypeDef CRC_Example_Calculate32Bit(void)
{
    uint32_t crc_value = 0;

    printf("Calculating CRC for 32-bit word data...\n");
    printf("Data: ");
    for (size_t i = 0; i < sizeof(example_data32) / sizeof(uint32_t); i++) {
        printf("%08X ", example_data32[i]);
    }
    printf("\n");

    /* Calculate CRC */
    HAL_StatusTypeDef status = CRC_Calculate32(example_data32,
                                               sizeof(example_data32) / sizeof(uint32_t),
                                               &crc_value);
    if (status != HAL_OK) {
        printf("CRC calculation failed!\n");
        return status;
    }

    printf("Calculated CRC: 0x%08X\n", crc_value);
    return HAL_OK;
}

/**
 * @brief Example 4: CRC accumulation (processing data in chunks)
 * @return HAL_StatusTypeDef HAL status
 */
HAL_StatusTypeDef CRC_Example_Accumulate(void)
{
    uint32_t crc_value = 0;
    uint8_t chunk1[] = {EXAMPLE_BYTE_1, EXAMPLE_BYTE_2, EXAMPLE_BYTE_3, EXAMPLE_BYTE_4};
    uint8_t chunk2[] = {EXAMPLE_BYTE_5, EXAMPLE_BYTE_6, EXAMPLE_BYTE_7, EXAMPLE_BYTE_8};

    printf("CRC accumulation example...\n");

    /* First chunk */
    printf("Processing first chunk: ");
    for (size_t i = 0; i < sizeof(chunk1); i++) {
        printf("%02X ", chunk1[i]);
    }
    printf("\n");

    HAL_StatusTypeDef status = CRC_Accumulate(chunk1, sizeof(chunk1), &crc_value);
    if (status != HAL_OK) {
        printf("CRC accumulation failed!\n");
        return status;
    }
    printf("CRC after first chunk: 0x%08X\n", crc_value);

    /* Second chunk */
    printf("Processing second chunk: ");
    for (size_t i = 0; i < sizeof(chunk2); i++) {
        printf("%02X ", chunk2[i]);
    }
    printf("\n");

    status = CRC_Accumulate(chunk2, sizeof(chunk2), &crc_value);
    if (status != HAL_OK) {
        printf("CRC accumulation failed!\n");
        return status;
    }
    printf("Final CRC: 0x%08X\n", crc_value);

    return HAL_OK;
}

/**
 * @brief Example 5: CRC with custom configuration
 * @return HAL_StatusTypeDef HAL status
 */
HAL_StatusTypeDef CRC_Example_CustomConfig(void)
{
    CRC_Config config;
    uint32_t crc_value = 0;

    printf("CRC with custom configuration (CRC-16-CCITT)...\n");

    /* Configure for CRC-16-CCITT */
    config.method = CRC_METHOD_SOFTWARE;
    config.polynomial = CRC_POLY_CRC16_CCITT;
    config.init_value = CRC16_INIT_VALUE;
    config.input_reverse = false;
    config.output_reverse = false;
    config.input_format = CRC_FORMAT_8BIT;
    config.output_format = CRC_FORMAT_16BIT;
    config.xor_output = true;
    config.xor_value = 0x0000;

    /* Initialize with custom config */
    HAL_StatusTypeDef status = CRC_Init(&config);
    if (status != HAL_OK) {
        printf("CRC initialization failed!\n");
        return status;
    }

    /* Calculate CRC */
    status = CRC_Calculate(example_data, sizeof(example_data), &crc_value);
    if (status != HAL_OK) {
        printf("CRC calculation failed!\n");
        return status;
    }

    printf("CRC-16-CCITT: 0x%04X\n", crc_value & CRC16_MASK);
    return HAL_OK;
}

/**
 * @brief Example 6: CRC with callbacks
 * @return HAL_StatusTypeDef HAL status
 */
HAL_StatusTypeDef CRC_Example_WithCallbacks(void)
{
    CRC_Config config;
    uint32_t crc_value = 0;

    printf("CRC with callback functions...\n");

    /* Get default configuration */
    CRC_GetDefaultConfig(&config);

    /* Register callbacks */
    CRC_RegisterCompleteCallback(CRC_CompleteCallback);
    CRC_RegisterErrorCallback(CRC_ErrorCallback);

    /* Initialize CRC */
    HAL_StatusTypeDef status = CRC_Init(&config);
    if (status != HAL_OK) {
        printf("CRC initialization failed!\n");
        return status;
    }

    /* Calculate CRC (callbacks will be triggered) */
    status = CRC_Calculate(example_data, sizeof(example_data), &crc_value);
    if (status != HAL_OK) {
        printf("CRC calculation failed!\n");
        return status;
    }

    printf("CRC calculation completed with callbacks\n");
    return HAL_OK;
}

/**
 * @brief Example 7: CRC status monitoring
 * @return HAL_StatusTypeDef HAL status
 */
HAL_StatusTypeDef CRC_Example_StatusMonitoring(void)
{
    uint32_t crc_value = 0;

    printf("CRC status monitoring example...\n");

    /* Perform some calculations */
    CRC_Calculate(example_data, sizeof(example_data), &crc_value);
    CRC_Calculate32(example_data32, sizeof(example_data32) / sizeof(uint32_t), &crc_value);

    /* Get status */
    HAL_StatusTypeDef status = CRC_GetStatus(&crc_status);
    if (status != HAL_OK) {
        printf("Failed to get CRC status!\n");
        return status;
    }

    printf("CRC Status:\n");
    printf("  Initialized: %s\n", crc_status.initialized ? "Yes" : "No");
    printf("  Current Method: %s\n",
           crc_status.current_method == CRC_METHOD_HARDWARE ? "Hardware" : "Software");
    printf("  Last CRC: 0x%08X\n", crc_status.last_calculated_crc);
    printf("  Total Calculations: %u\n", crc_status.calculation_count);
    printf("  Hardware Usage: %u\n", crc_status.hardware_usage_count);
    printf("  Software Usage: %u\n", crc_status.software_usage_count);
    printf("  Last Error: %d\n", crc_status.last_error);

    return HAL_OK;
}

/**
 * @brief Example 8: CRC reset functionality
 * @return HAL_StatusTypeDef HAL status
 */
HAL_StatusTypeDef CRC_Example_Reset(void)
{
    uint32_t crc1 = 0;
    uint32_t crc2 = 0;

    printf("CRC reset functionality example...\n");

    /* Calculate CRC */
    CRC_Calculate(example_data, sizeof(example_data), &crc1);
    printf("First CRC: 0x%08X\n", crc1);

    /* Reset CRC state */
    HAL_StatusTypeDef status = CRC_Reset();
    if (status != HAL_OK) {
        printf("CRC reset failed!\n");
        return status;
    }

    /* Calculate same data again */
    CRC_Calculate(example_data, sizeof(example_data), &crc2);
    printf("CRC after reset: 0x%08X\n", crc2);

    /* Should be the same */
    if (crc1 == crc2) {
        printf("CRC reset working correctly\n");
    } else {
        printf("CRC reset issue detected\n");
    }

    return HAL_OK;
}

/**
 * @brief Run all CRC examples
 * @return HAL_StatusTypeDef HAL status
 */
HAL_StatusTypeDef CRC_RunAllExamples(void)
{
    HAL_StatusTypeDef status = HAL_OK;

    printf("\n=== CRC Examples ===\n\n");

    /* Example 1: Basic initialization */
    printf("Example 1: Basic Initialization\n");
    status = CRC_Example_BasicInit();
    if (status != HAL_OK) {
        return status;
    }
    printf("\n");

    /* Example 2: Byte data calculation */
    printf("Example 2: Byte Data Calculation\n");
    status = CRC_Example_CalculateBytes();
    if (status != HAL_OK) {
        return status;
    }
    printf("\n");

    /* Example 3: 32-bit data calculation */
    printf("Example 3: 32-bit Data Calculation\n");
    status = CRC_Example_Calculate32Bit();
    if (status != HAL_OK) {
        return status;
    }
    printf("\n");

    /* Example 4: Accumulation */
    printf("Example 4: Data Accumulation\n");
    status = CRC_Example_Accumulate();
    if (status != HAL_OK) {
        return status;
    }
    printf("\n");

    /* Example 5: Custom configuration */
    printf("Example 5: Custom Configuration\n");
    status = CRC_Example_CustomConfig();
    if (status != HAL_OK) {
        return status;
    }
    printf("\n");

    /* Example 6: With callbacks */
    printf("Example 6: With Callbacks\n");
    status = CRC_Example_WithCallbacks();
    if (status != HAL_OK) {
        return status;
    }
    printf("\n");

    /* Example 7: Status monitoring */
    printf("Example 7: Status Monitoring\n");
    status = CRC_Example_StatusMonitoring();
    if (status != HAL_OK) {
        return status;
    }
    printf("\n");

    /* Example 8: Reset functionality */
    printf("Example 8: Reset Functionality\n");
    status = CRC_Example_Reset();
    if (status != HAL_OK) {
        return status;
    }
    printf("\n");

    printf("All CRC examples completed successfully!\n");
    return HAL_OK;
}

/* Callback function implementations */

/**
 * @brief CRC calculation complete callback
 * @param crc_value Calculated CRC value
 */
static void CRC_CompleteCallback(uint32_t crc_value)
{
    printf("CRC Complete Callback: Calculated CRC = 0x%08X\n", crc_value);
}

/**
 * @brief CRC error callback
 * @param error Error type
 */
static void CRC_ErrorCallback(CRC_ErrorType error)
{
    printf("CRC Error Callback: Error type = %d\n", error);
}
